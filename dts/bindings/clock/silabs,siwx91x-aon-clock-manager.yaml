## dts/bindings/clock/silabs,siwx91x-aon-clock-manager.yaml
```yaml
# Copyright (c) 2024-2026 Silicon Laboratories Inc.
# SPDX-License-Identifier: Apache-2.0

description: |
  SiWx91x Always-On (AON) / NPSS clock manager.

  Controls clocks for the always-on domain: RTC, watchdog timer, and the
  reference clock selection for the M4SS and ULPSS subsystems during sleep
  and wake transitions.

  SIWX91X_CLK_RTC and SIWX91X_CLK_WATCHDOG use a fixed UULP LF reference;
  do not add clock-route children for them. SIWX91X_CLK_SYSRTC is owned by
  the sleeptimer stack, not by clock-route children here.

compatible: "silabs,siwx91x-aon-clock-manager"

include: [clock-controller.yaml, base.yaml]

properties:
  reg:
    required: true

  reg-names:
    type: string-array
    required: true
    description: |
      Register block for the AON/NPSS clock manager:
        - mcu-aon: MCU AON/NPSS power and low-frequency clock control

  "#clock-cells":
    const: 1

clock-cells:
  - clkid
```

## dts/bindings/clock/silabs,siwx91x-hp-clock-manager.yaml
```yaml
# Copyright (c) 2024-2026 Silicon Laboratories Inc.
# SPDX-License-Identifier: Apache-2.0

description: |
  SiWx91x High Performance (HP) clock manager.

  Controls clocks for the M4SS (Cortex-M4 subsystem): UARTs, I2Cs, SPI,
  I2S, DMA, PWM, QSPI, GPDMA, and RNG. Also owns the SoC PLL, INTF PLL,
  and I2S PLL configuration registers.

compatible: "silabs,siwx91x-hp-clock-manager"

include: [clock-controller.yaml, base.yaml]

properties:
  reg:
    required: true

  reg-names:
    type: string-array
    required: true
    description: |
      Register blocks for the HP clock manager:
        - m4clk: M4SS (HP) peripheral clock enable and configuration
        - misc-config: HP miscellaneous control registers (e.g. I2S master mode)
        - pll: SoC PLL, INTF PLL, and I2S PLL configuration

  "#clock-cells":
    const: 1

clock-cells:
  - clkid
```

## dts/bindings/clock/silabs,siwx91x-pll.yaml
```yaml
# Copyright (c) 2026 Silicon Laboratories Inc.
# SPDX-License-Identifier: Apache-2.0

description: |
  SiWx91x PLL output description.

  This binding models the three PLL outputs owned by the HP clock manager:
  SoC PLL, INTF PLL, and I2S PLL. The node is primarily descriptive and is
  consumed by the SiWx91x HP clock control driver to apply boot-time defaults
  PLL configuration.

compatible: "silabs,siwx91x-pll"

include: [clock-controller.yaml, base.yaml]

properties:
  clocks:
    type: phandle-array
    required: true
    description: |
      Must reference the shared HP PLL reference route
      (silabs,siwx91x-clock-route child, e.g. hp_pll_ref_mux). All PLLs share
      the same hardware reference mux; do not point each PLL at xtal/rc directly.

  clock-frequency:
    type: int
    required: true
    description: Target PLL output frequency in Hz.

  "#clock-cells":
    const: 0
```
