## drivers/clock_control/Kconfig.fake
```kconfig
# Copyright (c) 2025 Silicon Laboratories Inc.
# SPDX-License-Identifier: Apache-2.0

config CLOCK_CONTROL_FAKE
	bool "Generic clock control fake driver"
	default y
	depends on DT_HAS_ZEPHYR_CLOCK_CONTROL_FAKE_ENABLED
	help
	  Enable generic fake clock control driver.
	  This provides empty implementations of clock control functions
	  Use compatible "zephyr,clock-control-fake" in DTS overlay.
```

## drivers/dma/Kconfig.fake
```kconfig
# Copyright (c) 2025 Silicon Laboratories Inc.
# SPDX-License-Identifier: Apache-2.0

config DMA_FAKE
	bool "Generic DMA fake driver"
	default y
	depends on DT_HAS_ZEPHYR_DMA_FAKE_ENABLED || DT_HAS_ZEPHYR_DMA_FAKE_2CELL_ENABLED
	help
	  Enable generic stub for DMA driver.
	  This provides empty implementations of DMA functions.
	  Use compatible "zephyr,dma-fake" in DTS overlay.
```

## drivers/gpio/Kconfig.fake
```kconfig
# Copyright (c) 2025 Silicon Laboratories Inc.
# SPDX-License-Identifier: Apache-2.0

config GPIO_FAKE
	bool "Generic GPIO fake driver"
	default y
	depends on DT_HAS_ZEPHYR_GPIO_FAKE_ENABLED
	help
	  Enable generic fake GPIO driver.
	  This provides empty implementations of GPIO functions.
	  Use compatible "zephyr,gpio-fake" in DTS overlay.
```

## drivers/pinctrl/Kconfig.fake
```kconfig
# Copyright (c) 2025 Silicon Laboratories Inc.
# SPDX-License-Identifier: Apache-2.0

config PINCTRL_FAKE
	bool "Generic pinctrl fake driver"
	default y
	depends on DT_HAS_ZEPHYR_PINCTRL_FAKE_ENABLED
	help
	  Enable generic fake pinctrl driver.
	  This provides empty implementations of pinctrl functions.
	  Use compatible "zephyr,pinctrl-fake" in DTS overlay.
```

## drivers/serial/Kconfig.silabs_usart
```kconfig
# Silabs USART

# Copyright (c) 2024, Silicon Laboratories
# SPDX-License-Identifier: Apache-2.0

config UART_SILABS_USART
	bool "Silabs USART driver"
	default y
	depends on DT_HAS_SILABS_USART_ENABLED
	select SERIAL_HAS_DRIVER
	select SERIAL_SUPPORT_INTERRUPT
	select SOC_GECKO_USART
	select SERIAL_SUPPORT_ASYNC \
		if DT_HAS_SILABS_LDMA_ENABLED
	select DMA if UART_ASYNC_API
	select PINCTRL
	select CLOCK_CONTROL
	select PM_DEVICE if PM
	help
	  Enable the silabs usart driver.
```

## dts/bindings/clock/zephyr,clock-control-fake.yaml
```yaml
# Copyright (c) 2025 Silicon Laboratories Inc.
# SPDX-License-Identifier: Apache-2.0

description: |
  Generic fake clock controller.
  This driver provides empty implementations of clock control functions.

compatible: "zephyr,clock-control-fake"

include: [clock-controller.yaml, base.yaml]

properties:
  reg:
    required: true

  "#clock-cells":
    const: 1

clock-cells:
  - clkid
```

## dts/bindings/dma/zephyr,dma-fake-2cell.yaml
```yaml
# Copyright (c) 2025 Silicon Laboratories Inc.
# SPDX-License-Identifier: Apache-2.0

description: |
  Generic fake DMA controller for resource tracking.
  This driver provides empty implementations of DMA functions.

compatible: "zephyr,dma-fake-2cell"

include: dma-controller.yaml

properties:
  reg:
    required: true

  "#dma-cells":
    const: 2

dma-cells:
  - channel
  - slot
```

## dts/bindings/gpio/zephyr,gpio-fake-port.yaml
```yaml
# Copyright (c) 2025 Silicon Laboratories Inc.
# SPDX-License-Identifier: Apache-2.0

description: |
  Generic fake GPIO controller for resource tracking.
  This driver provides empty implementations of GPIO functions.

compatible: "zephyr,gpio-fake-port"

include: [gpio-controller.yaml, base.yaml]

properties:
  reg:
    required: true

  "#gpio-cells":
    const: 2

gpio-cells:
  - pin
  - flags
```

## dts/bindings/gpio/zephyr,gpio-fake.yaml
```yaml
# Copyright (c) 2025 Silicon Laboratories Inc.
# SPDX-License-Identifier: Apache-2.0

description: |
  Generic fake GPIO controller for resource tracking.
  This driver provides empty implementations of GPIO functions.

compatible: "zephyr,gpio-fake"

include: [gpio-controller.yaml, base.yaml]

properties:
  reg:
    required: true

  "#gpio-cells":
    const: 0
```

## dts/bindings/pinctrl/zephyr,pinctrl-fake.yaml
```yaml
# Copyright (c) 2025 Silicon Laboratories Inc.
# SPDX-License-Identifier: Apache-2.0

description: |
  Generic fake pinctrl for resource tracking.
  This driver provides empty implementations of pinctrl functions.

compatible: "zephyr,pinctrl-fake"

include: base.yaml

child-binding:
  description: |
    Pin configuration. Each child node defines
    the configuration for a particular group of pins.
  child-binding:
    description: |
      Pin configuration group.
    include:
      - name: pincfg-node.yaml
        property-allowlist: []

    properties:
      pinmux:
        required: true
        type: array
        description: |
          An array of pins sharing the same group properties. The pins should be
          defined using the <peripheral>_<signal>_<pin> macros available from
          the SoC DeviceTree files.
```

## dts/bindings/serial/silabs,usart.yaml
```yaml
description: Silabs USART

compatible: "silabs,usart"

include: [uart-controller.yaml, pinctrl-device.yaml]

properties:
  reg:
    required: true

  interrupts:
    required: true

  peripheral-id:
    type: int
    description: peripheral ID

  current-speed:
    description: |
      Initial baud rate setting for UART. Defaults to standard baudrate of 115200 if not specified.
    default: 115200

  parity:
    description: |
      Configures the parity of the adapter
    default: "none"

  stop-bits:
    description: |
      Sets the number of stop bits. Defaults to standard of 1 if not specified.
    default: "1"

  data-bits:
    description: |
      Sets the number of data bits. Defaults to standard of 8 if not specified.
    default: 8
```

## tests/boards/silabs/dma/block_append/Kconfig
```kconfig
# Copyright (c) 2025 Silicon Laboratories Inc.
# SPDX-License-Identifier: Apache-2.0

mainmenu "DMA block append Test"

source "Kconfig.zephyr"

config DMA_BA_CHANNEL_NR
	int "DMA channel to use"
	default 0

config DMA_BA_XFER_SIZE
	int "Number of bytes to transfer"
	default 4096
```

## tests/boards/silabs/dma/block_append/testcase.yaml
```yaml
tests:
  boards.silabs.dma.block_append:
    depends_on: dma
    tags:
      - drivers
      - dma
    platform_allow:
      - silabs/radio_boards/slwrb4180a  
    filter: dt_alias_exists("dma0")
    integration_platforms:
      - silabs/radio_boards/slwrb4180a 
```

## tests/drivers/uart/uart_async_api/boards/slwrb4180a.conf
```kconfig
CONFIG_UART_LOG_LEVEL_DBG=y
CONFIG_DMA_LOG_LEVEL_DBG=y
CONFIG_DEBUG_OPTIMIZATIONS=y
```
