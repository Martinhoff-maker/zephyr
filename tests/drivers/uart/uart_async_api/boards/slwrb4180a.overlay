/*
 * Copyright (c) 2024, Silicon Laboratories
 *
 * SPDX-License-Identifier: Apache-2.0
 */

dut: &usart0 {
	dmas = <&dma0 0 SILABS_LDMA_SIG_USART0_TXBL 1>,
		<&dma0 1 SILABS_LDMA_SIG_USART0_RXDATAV 2>;
	dma-names = "tx", "rx";
	current-speed = <115200>;
	status = "okay";
};

&dma0 {
	status = "okay";
};